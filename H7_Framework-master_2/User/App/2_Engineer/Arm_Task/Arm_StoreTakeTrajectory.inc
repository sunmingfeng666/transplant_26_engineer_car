/* 从旧 One_Click_Task.c 原样迁移的存矿/取矿轨迹系数。 */
#define ARM_TRAJ_SEG_STORE1 22


// 每段轨迹的起始时间节点。
static const float t_knots_store1[23] = {
    0.0000f, 0.0382f, 0.0764f, 0.1145f, 0.1527f, 0.1909f, 0.2291f, 0.2673f, 
    0.3055f, 0.3436f, 0.3818f, 0.4200f, 0.4582f, 0.4964f, 0.5345f, 0.5727f, 
    0.6109f, 0.6491f, 0.6873f, 0.7255f, 0.7636f, 0.8018f, 0.8400f
};

// 三次多项式系数：q_coeffs[关节索引][分段索引][a,b,c,d]
static const float q_coeffs_store1[6][22][4] = {
    { // ===== 关节 q1 =====
        {    -0.083437f,    -0.250325f,     0.108320f,    -3.605135f },
        {    -0.083437f,    -0.283776f,     0.036945f,    -3.595329f },
        {     2.270264f,    -0.317227f,    -0.043371f,    -3.595659f },
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        {    -3.277159f,    -0.487189f,     0.134528f,    -3.278521f }
    },

    { // ===== 关节 q2 =====
        {     0.757961f,    -1.033015f,    -0.037171f,     0.167277f },
        {     0.757961f,    -0.729142f,    -0.272660f,     0.145670f },
        {     1.395702f,    -0.425268f,    -0.426931f,     0.098020f },
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        {     0.116583f,    -0.053391f,     0.005053f,    -0.109293f }
    },

    { // ===== 关节 q3 =====
        {    -0.010302f,     0.004130f,    -0.000368f,     4.505798f },
        {    -0.010302f,     0.000000f,     0.000184f,     4.505798f },
        {     0.051511f,    -0.004130f,    -0.000368f,     4.505798f },
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        {     2.020300f,     0.348840f,    -0.101374f,     4.737180f }
    },

    { // ===== 关节 q4 =====
        {     1.643257f,    -1.037195f,     0.027834f,     1.118296f },
        {     1.643257f,    -0.378398f,    -0.161340f,     1.107415f },
        {    -0.842844f,     0.280399f,    -0.174436f,     1.083018f },
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        {    -0.292996f,    -0.016538f,     0.012368f,     1.201180f }
    },

    { // ===== 关节 q5 =====
        {    -0.046300f,     0.021711f,    -0.001070f,    -0.734531f },
        {    -0.046300f,     0.003148f,     0.002252f,    -0.734397f },
        {     0.080999f,    -0.015414f,     0.000613f,    -0.734150f },
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        {     0.054189f,    -0.000000f,    -0.000968f,    -0.794805f }
    },

    { // ===== 关节 q6 =====
        {    -1.321136f,     0.499542f,    -0.027720f,     0.026512f },
        {    -1.321136f,    -0.030114f,     0.035013f,     0.028576f },
        {     7.471948f,    -0.559770f,    -0.043817f,     0.029564f },
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        {    -2.246382f,    -0.213621f,     0.068665f,     0.457580f }
    }
};
#define ARM_TRAJ_SEG_STORE2 16


// 每段轨迹的起始时间节点。
static const float t_knots_store2[17] = {
    0.0000f, 0.0382f, 0.0765f, 0.1147f, 0.1530f, 0.1912f, 0.2295f, 0.2677f, 
    0.3060f, 0.3442f, 0.3825f, 0.4207f, 0.4590f, 0.4972f, 0.5355f, 0.5737f, 
    0.6120f
};

// 三次多项式系数：q_coeffs[关节索引][分段索引][a,b,c,d]
static const float q_coeffs_store2[6][16][4] = {
    { // ===== 关节 q1 =====
        {     0.530482f,    -0.269306f,     0.022678f,    -3.258373f },
        {     0.530482f,    -0.056253f,    -0.020906f,    -3.258891f },
        {    -0.597012f,     0.156800f,    -0.007446f,    -3.261425f },
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        {    -1.049496f,     0.131536f,     0.058701f,    -3.801663f }
    },

    { // ===== 关节 q2 =====
        {    -0.634580f,     0.999287f,     0.061154f,    -0.107767f },
        {    -0.634580f,     0.744426f,     0.294592f,    -0.083193f },
        {    -0.810635f,     0.489564f,     0.459791f,    -0.031936f },
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        {    -0.612847f,     0.109077f,    -0.003619f,     0.401121f }
    },

    { // ===== 关节 q3 =====
        {     0.149248f,    -0.081228f,     0.008199f,     4.781223f },
        {     0.149248f,    -0.021286f,    -0.005525f,     4.781223f },
        {    -0.110227f,     0.038655f,    -0.003199f,     4.780460f },
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        {    -0.180544f,     0.251605f,    -0.065151f,     4.569574f }
    },

    { // ===== 关节 q4 =====
        {    -1.969319f,     1.116137f,    -0.037615f,     1.198024f },
        {    -1.969319f,     0.325216f,     0.155344f,     1.208267f },
        {     1.703554f,    -0.465706f,     0.136536f,     1.230167f },
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        {    -1.614872f,    -0.000000f,     0.028942f,     1.260204f }
    },

    { // ===== 关节 q5 =====
        {     1.850185f,    -1.473557f,     0.111214f,    -0.794805f },
        {     1.850185f,    -0.730482f,    -0.183849f,    -0.801887f },
        {     2.769971f,     0.012592f,    -0.279956f,    -0.835152f },
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        {     0.139034f,     0.002282f,    -0.003919f,    -0.879342f }
    },

    { // ===== 关节 q6 =====
        {    -0.000679f,     0.000273f,    -0.000024f,     0.476273f },
        {    -0.000679f,     0.000000f,     0.000012f,     0.476273f },
        {     0.003393f,    -0.000273f,    -0.000024f,     0.476273f },
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        {     0.809878f,     0.053237f,    -0.018788f,     0.017738f }
    }
};
#define ARM_TRAJ_SEG_TAKE1 40


// 每段轨迹的起始时间节点。
static const float t_knots_take1[41] = {
    0.0000f, 0.0189f, 0.0378f, 0.0567f, 0.0756f, 0.0945f, 0.1134f, 0.1323f, 
    0.1512f, 0.1701f, 0.1890f, 0.2079f, 0.2268f, 0.2457f, 0.2646f, 0.2835f, 
    0.3024f, 0.3213f, 0.3402f, 0.3591f, 0.3780f, 0.3969f, 0.4158f, 0.4347f, 
    0.4536f, 0.4725f, 0.4914f, 0.5103f, 0.5292f, 0.5481f, 0.5670f, 0.5859f, 
    0.6048f, 0.6237f, 0.6426f, 0.6615f, 0.6804f, 0.6993f, 0.7182f, 0.7371f, 
    0.7560f
};

// 三次多项式系数：q_coeffs[关节索引][分段索引][a,b,c,d]
static const float q_coeffs_take1[6][40][4] = {
    { // ===== 关节 q1 =====
        {    -2.775905f,     0.607131f,    -0.010387f,    -3.271343f },
        {    -2.775905f,     0.213646f,     0.028395f,    -3.270771f },
        {     1.158299f,    -0.179838f,     0.029993f,    -3.269245f },
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        {     1.067578f,     0.129668f,    -0.000426f,    -3.222134f }
    },

    { // ===== 关节 q2 =====
        {    -0.733208f,     0.104357f,    -0.065864f,     0.263027f },
        {    -0.733208f,     0.000425f,    -0.060913f,     0.260071f },
        {    -2.585552f,    -0.103507f,    -0.065784f,     0.257116f },
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        {    -1.627292f,    -0.421996f,    -0.129848f,    -0.031090f }
    },

    { // ===== 关节 q3 =====
        {     0.000025f,    -0.000004f,     0.000000f,     4.767109f },
        {     0.000025f,     0.000000f,    -0.000000f,     4.767109f },
        {    -0.000124f,     0.000004f,     0.000000f,     4.767109f },
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        {    -0.005139f,     0.000000f,     0.000011f,     4.775883f }
    },

    { // ===== 关节 q4 =====
        {     0.026760f,    -0.003793f,     0.000119f,     1.688983f },
        {     0.026760f,     0.000000f,    -0.000060f,     1.688983f },
        {    -0.133802f,     0.003793f,     0.000119f,     1.688983f },
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        {     0.212225f,    -0.081679f,    -0.067267f,     1.588178f }
    },

    { // ===== 关节 q5 =====
        {     0.822892f,    -0.116645f,     0.003674f,    -0.407989f },
        {     0.822892f,     0.000000f,    -0.001837f,    -0.407989f },
        {    -1.430424f,     0.116645f,     0.003674f,    -0.407989f },
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        {    -1.748048f,    -0.085552f,     0.007945f,    -0.242046f }
    },

    { // ===== 关节 q6 =====
        {    -0.000000f,     0.000000f,    -0.000000f,     0.602160f },
        {    -0.000000f,    -0.000000f,     0.000000f,     0.602160f },
        {     0.000000f,    -0.000000f,    -0.000000f,     0.602160f },
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        {     0.000454f,    -0.000000f,    -0.000001f,     0.602541f }
    }
};
#define ARM_TRAJ_SEG_TAKE2 14


// 每段轨迹的起始时间节点。
static const float t_knots_take2[15] = {
    0.0000f, 0.0696f, 0.1392f, 0.2088f, 0.2784f, 0.3480f, 0.4176f, 0.4872f, 
    0.5568f, 0.6264f, 0.6960f, 0.7656f, 0.8352f, 0.9048f, 0.9744f
};

// 三次多项式系数：q_coeffs[关节索引][分段索引][a,b,c,d]
static const float q_coeffs_take2[6][14][4] = {
    { // ===== 关节 q1 =====
        {     0.824693f,    -1.107613f,     0.080990f,    -3.239681f },
        {     0.824693f,    -0.677120f,    -0.229556f,    -3.254779f },
        {     1.091453f,    -0.246627f,    -0.390289f,    -3.310878f },
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        {    -0.805678f,     0.205150f,    -0.006918f,    -3.657016f }
    },

    { // ===== 关节 q2 =====
        {     0.066212f,    -0.018476f,     0.001210f,    -0.045205f },
        {     0.066212f,     0.016087f,     0.000794f,    -0.045205f },
        {    -0.171917f,     0.050650f,     0.012407f,    -0.044231f },
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        {     0.144817f,     0.000000f,    -0.004385f,     0.251965f }
    },

    { // ===== 关节 q3 =====
        {    -0.155236f,    -0.030912f,     0.010079f,     4.781986f },
        {    -0.155236f,    -0.111946f,    -0.014779f,     4.781986f },
        {     0.694901f,    -0.192980f,    -0.067836f,     4.775207f },
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        {    -0.030185f,     0.103378f,    -0.141262f,     4.504519f }
    },

    { // ===== 关节 q4 =====
        {     0.315962f,    -0.282498f,     0.039589f,     1.576066f },
        {     0.315962f,    -0.117564f,    -0.030023f,     1.576066f },
        {    -0.732903f,     0.047369f,    -0.042237f,     1.568947f },
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        {    -0.429488f,    -0.006309f,     0.014101f,     1.522278f }
    },

    { // ===== 关节 q5 =====
        {     0.052061f,    -0.037079f,     0.007694f,    -0.236324f },
        {     0.052061f,    -0.009903f,    -0.000481f,    -0.235834f },
        {    -0.063514f,     0.017273f,     0.000801f,    -0.235943f },
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        {     0.002870f,     0.002601f,    -0.001185f,    -0.304115f }
    },

    { // ===== 关节 q6 =====
        {     2.796366f,    -2.107842f,     0.148976f,     0.601015f },
        {     2.796366f,    -0.648127f,    -0.330567f,     0.577851f },
        {    -3.661988f,     0.811587f,    -0.302124f,     0.515440f },
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        {    -0.658172f,     0.013494f,     0.019775f,     0.214961f }
    }
};
